## conf/machine/beagleboneai.conf
```bitbake
#@TYPE: Machine
#@NAME: BeagleBone AI
#@DESCRIPTION: Machine configuration for the BeagleBone AI

SOC_FAMILY = "ti57xx"
TARGET_ARCH = "arm"

DEFAULTTUNE ?= "cortexa15hf-neon"

require conf/machine/include/soc-family.inc
require conf/machine/include/tune-cortexa15.inc

PREFERRED_PROVIDER_virtual/kernel = "linux-stable"
KERNEL_IMAGETYPE = "zImage"

PREFERRED_PROVIDER_virtual/bootloader = "u-boot"
PREFERRED_PROVIDER_u-boot = "u-boot"

UBOOT_ENTRYPOINT = "0x80008000"
UBOOT_LOADADDRESS = "0x80008000"
UBOOT_MACHINE = "am57xx_evm_defconfig"
BOOTENV_SIZE = "0x20000"

EXTRA_IMAGEDEPENDS += "u-boot"

SERIAL_CONSOLES = "115200;ttyO0 115200;ttyO2"

IMAGE_FSTYPES = "ext4"

MACHINE_ESSENTIAL_EXTRA_RDEPENDS = "kernel-image kernel-devicetree"

MACHINE_FEATURES = "ext2 serial usbhost vfat"
```
